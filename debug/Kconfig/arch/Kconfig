## debug/Kconfig/arch/Kconfig
```kconfig
# Load Zephyr Arch Kconfig descriptions.
osource "C:/Users/mauri/VSCode/zephyr/zephyr/arch/rx/Kconfig"
osource "C:/Users/mauri/VSCode/zephyr/zephyr/arch/x86/Kconfig"
osource "C:/Users/mauri/VSCode/zephyr/zephyr/arch/xtensa/Kconfig"
osource "C:/Users/mauri/VSCode/zephyr/zephyr/arch/sparc/Kconfig"
osource "C:/Users/mauri/VSCode/zephyr/zephyr/arch/riscv/Kconfig"
osource "C:/Users/mauri/VSCode/zephyr/zephyr/arch/posix/Kconfig"
osource "C:/Users/mauri/VSCode/zephyr/zephyr/arch/mips/Kconfig"
osource "C:/Users/mauri/VSCode/zephyr/zephyr/arch/arm64/Kconfig"
osource "C:/Users/mauri/VSCode/zephyr/zephyr/arch/arm/Kconfig"
osource "C:/Users/mauri/VSCode/zephyr/zephyr/arch/arc/Kconfig"
```

## debug/Kconfig/boards/Kconfig
```kconfig
# Load Zephyr board Kconfig descriptions.
osource "C:/Users/mauri/VSCode/zephyr/zephyr/boards/nxp/frdm_k64f/Kconfig"
```

## debug/Kconfig/boards/Kconfig.defconfig
```kconfig
# Load Zephyr board defconfig descriptions.
osource "C:/Users/mauri/VSCode/zephyr/zephyr/boards/nxp/frdm_k64f/Kconfig.defconfig"
```

## debug/Kconfig/boards/Kconfig.frdm_k64f
```kconfig
# Load board Kconfig descriptions.
osource "C:/Users/mauri/VSCode/zephyr/zephyr/boards/nxp/frdm_k64f/Kconfig.frdm_k64f"
```
